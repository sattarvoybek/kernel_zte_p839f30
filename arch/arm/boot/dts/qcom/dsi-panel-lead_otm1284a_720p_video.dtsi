/* Copyright (c) 2013, The Linux Foundation. All rights reserved.
 *
 * This program is free software; you can redistribute it and/or modify
 * it under the terms of the GNU General Public License version 2 and
 * only version 2 as published by the Free Software Foundation.
 *
 * This program is distributed in the hope that it will be useful,
 * but WITHOUT ANY WARRANTY; without even the implied warranty of
 * MERCHANTABILITY or FITNESS FOR A PARTICULAR PURPOSE.  See the
 * GNU General Public License for more details.
 */

/*---------------------------------------------------------------------------
 * This file is autogenerated file using gcdb parser. Please do not edit it.
 * Update input XML file to add a new entry or update variable in this file
 * VERSION = "1.0"
 *---------------------------------------------------------------------------*/
&mdss_mdp {
	dsi_lead_otm1284a_720p_video: qcom,mdss_dsi_lead_otm1284a_720p_video {
		qcom,mdss-dsi-panel-name = "lead otm1284a 720p video";
		qcom,cont-splash-enabled;
		qcom,mdss-dsi-panel-controller = <&mdss_dsi0>;
		qcom,mdss-dsi-panel-type = "dsi_video_mode";
		qcom,mdss-dsi-panel-destination = "display_1";
		qcom,mdss-dsi-panel-framerate = <60>;
		qcom,mdss-dsi-virtual-channel-id = <0>;
		qcom,mdss-dsi-stream = <0>;
		qcom,mdss-dsi-panel-width = <720>;
		qcom,mdss-dsi-panel-height = <1280>;
		qcom,mdss-dsi-h-front-porch = <96>;
		qcom,mdss-dsi-h-back-porch = <72>;
		qcom,mdss-dsi-h-pulse-width = <40>;
		qcom,mdss-dsi-h-sync-skew = <0>;
		qcom,mdss-dsi-v-back-porch = <4>;
		qcom,mdss-dsi-v-front-porch = <12>;
		qcom,mdss-dsi-v-pulse-width = <4>;
		qcom,mdss-dsi-h-left-border = <0>;
		qcom,mdss-dsi-h-right-border = <0>;
		qcom,mdss-dsi-v-top-border = <0>;
		qcom,mdss-dsi-v-bottom-border = <0>;
		qcom,mdss-dsi-bpp = <24>;
		qcom,mdss-dsi-color-order = "rgb_swap_rgb";
		qcom,mdss-dsi-underflow-color = <0xff>;
		qcom,mdss-dsi-border-color = <0>;
		qcom,mdss-dsi-on-command = [29 01 00 00 00 00 02 00 00 
29 01 00 00 00 00 04 ff 12 84 01 
29 01 00 00 00 00 02 00 80 
29 01 00 00 00 00 03 ff 12 84 
29 01 00 00 00 00 02 00 92 
29 01 00 00 00 00 03 ff 30 02 
29 01 00 00 00 00 02 00 80 
29 01 00 00 00 00 0a c0 00 64 00 10 10 00 64 10 10 
29 01 00 00 00 00 02 00 90 
29 01 00 00 00 00 07 c0 00 5c 00 01 00 04 
29 01 00 00 00 00 02 00 b3 
29 01 00 00 00 00 03 c0 00 55 
29 01 00 00 00 00 02 00 81 
29 01 00 00 00 00 02 c1 55 
29 01 00 00 00 00 02 00 a0 
29 01 00 00 00 00 0f c4 05 10 06 02 05 15 10 05 10 07 02 05 15 10 
29 01 00 00 00 00 02 00 b0 
29 01 00 00 00 00 03 c4 00 00 
29 01 00 00 00 00 02 00 91 
29 01 00 00 00 00 03 c5 46 42 
29 01 00 00 00 00 02 00 00 
29 01 00 00 00 00 03 d8 bc bc 
29 01 00 00 00 00 02 00 00 
29 01 00 00 00 00 02 d9 8d 
29 01 00 00 00 00 02 00 b3 
29 01 00 00 00 00 02 c5 84 
29 01 00 00 00 00 02 00 bb 
29 01 00 00 00 00 02 c5 8a 
29 01 00 00 00 00 02 00 82 
29 01 00 00 00 00 02 C4 0a 
29 01 00 00 00 00 02 00 c6 
29 01 00 00 00 00 02 B0 03 
29 01 00 00 00 00 02 00 c2 
29 01 00 00 00 00 02 f5 40 
29 01 00 00 00 00 02 00 c3 
29 01 00 00 00 00 02 f5 85 
29 01 00 00 00 00 02 00 87 
29 01 00 00 00 00 02 c4 18 
29 01 00 00 00 00 02 00 00 
29 01 00 00 00 00 02 d0 40 
29 01 00 00 00 00 02 00 00 
29 01 00 00 00 00 03 d1 00 00 
29 01 00 00 00 00 02 00 80 
29 01 00 00 00 00 0c cb 00 00 00 00 00 00 00 00 00 00 00 
29 01 00 00 00 00 02 00 90 
29 01 00 00 00 00 10 cb 00 00 00 00 00 00 00 00 00 00 00 00 00 00 00 
29 01 00 00 00 00 02 00 a0 
29 01 00 00 00 00 10 cb 00 00 00 00 00 00 00 00 00 00 00 00 00 00 00 
29 01 00 00 00 00 02 00 b0 
29 01 00 00 00 00 10 cb 00 00 00 00 00 00 00 00 00 00 00 00 00 00 00 
29 01 00 00 00 00 02 00 c0 
29 01 00 00 00 00 10 cb 05 05 05 05 05 00 00 00 00 00 00 00 00 00 00 
29 01 00 00 00 00 02 00 d0 
29 01 00 00 00 00 10 cb ff ff ff 00 05 05 05 05 05 05 05 05 00 00 00 
29 01 00 00 00 00 02 00 e0 
29 01 00 00 00 00 0f cb 00 00 00 00 00 00 00 ff ff ff 00 05 05 05 
29 01 00 00 00 00 02 00 f0 
29 01 00 00 00 00 0c cb ff ff ff ff ff ff ff ff ff ff ff 
29 01 00 00 00 00 02 00 80 
29 01 00 00 00 00 10 cc 02 0a 0c 0e 10 00 00 00 00 00 00 00 00 00 00 
29 01 00 00 00 00 02 00 90 
29 01 00 00 00 00 10 cc 00 00 00 00 2e 2d 06 01 09 0b 0d 0f 00 00 00 
29 01 00 00 00 00 02 00 a0 
29 01 00 00 00 00 0f cc 00 00 00 00 00 00 00 00 00 00 00 2e 2d 05 
29 01 00 00 00 00 02 00 b0 
29 01 00 00 00 00 10 cc 05 0f 0d 0b 09 00 00 00 00 00 00 00 00 00 00 
29 01 00 00 00 00 02 00 c0 
29 01 00 00 00 00 10 cc 00 00 00 00 2d 2e 01 06 10 0e 0c 0a 00 00 00 
29 01 00 00 00 00 02 00 d0 
29 01 00 00 00 00 0f cc 00 00 00 00 00 00 00 00 00 00 00 2d 2e 02 
29 01 00 00 00 00 02 00 80 
29 01 00 00 00 00 0d ce 87 03 10 86 03 10 00 00 00 00 00 00 
29 01 00 00 00 00 02 00 90 
29 01 00 00 00 00 0f ce 35 01 10 35 02 10 00 00 00 00 00 00 00 00 
29 01 00 00 00 00 02 00 a0 
29 01 00 00 00 00 0f ce 38 03 04 f8 00 10 00 38 02 04 f9 00 10 00 
29 01 00 00 00 00 02 00 b0 
29 01 00 00 00 00 0f ce 38 01 04 fa 00 10 00 38 00 04 fb 00 10 00 
29 01 00 00 00 00 02 00 c0 
29 01 00 00 00 00 0f ce 30 00 04 fc 00 10 00 30 01 04 fd 00 10 00 
29 01 00 00 00 00 02 00 d0 
29 01 00 00 00 00 0f ce 30 02 04 fe 00 10 00 30 03 04 ff 00 10 00 
29 01 00 00 00 00 02 00 80 
29 01 00 00 00 00 0f cf 00 00 00 00 00 00 00 00 00 00 00 00 00 00 
29 01 00 00 00 00 02 00 90 
29 01 00 00 00 00 0f cf 00 00 00 00 00 00 00 00 00 00 00 00 00 00 
29 01 00 00 00 00 02 00 a0 
29 01 00 00 00 00 0f cf 00 00 00 00 00 00 00 00 00 00 00 00 00 00 
29 01 00 00 00 00 02 00 b0 
29 01 00 00 00 00 0f cf 00 00 00 00 00 00 00 00 00 00 00 00 00 00 
29 01 00 00 00 00 02 00 c0 
29 01 00 00 00 00 0c cf 01 01 20 20 00 00 01 81 00 03 08 
29 01 00 00 00 00 02 00 b5 
29 01 00 00 00 00 07 c5 3f ff ff 3f ff ff 
29 01 00 00 00 00 02 00 90 
29 01 00 00 00 00 05 f5 02 11 02 15 
29 01 00 00 00 00 02 00 90 
29 01 00 00 00 00 02 c5 50 
29 01 00 00 00 00 02 00 94 
29 01 00 00 00 00 02 c5 66 
29 01 00 00 00 00 02 00 b2 
29 01 00 00 00 00 03 f5 00 00 
29 01 00 00 00 00 02 00 b4 
29 01 00 00 00 00 03 f5 00 00 
29 01 00 00 00 00 02 00 b6 
29 01 00 00 00 00 03 f5 00 00 
29 01 00 00 00 00 02 00 b8 
29 01 00 00 00 00 03 f5 00 00 
29 01 00 00 00 00 02 00 94 
29 01 00 00 00 00 03 f5 00 00 
29 01 00 00 00 00 02 00 d2 
29 01 00 00 00 00 03 f5 06 15 
29 01 00 00 00 00 02 00 b4 
29 01 00 00 00 00 02 c5 cc 
29 01 00 00 00 00 02 00 00 
29 01 00 00 00 00 15 E1 00 11 1e 2b 3b 49 4c 7a 6e 8b 75 5d 6c 47 42 33 25 16 09 00 
29 01 00 00 00 00 02 00 00 
29 01 00 00 00 00 15 E2 00 11 1e 2b 3b 49 4c 7a 6e 8b 73 5b 6c 42 42 33 25 16 09 00 
29 01 00 00 00 00 02 00 A0
29 01 00 00 00 00 0d D6 01 0d 01 0d 01 a6 01 a6 01 a6 01 a6
29 01 00 00 00 00 02 00 B0
29 01 00 00 00 00 0d D6 01 a6 01 a6 01 a6 01 a6 01 a6 01 a6
29 01 00 00 00 00 02 00 C0
29 01 00 00 00 00 0d D6 55 11 09 6f 11 6f 6f 11 6f 6f 11 6f
29 01 00 00 00 00 02 00 D0
29 01 00 00 00 00 07 D6 6f 11 6f 6f 11 6f
29 01 00 00 00 00 02 00 E0
29 01 00 00 00 00 0d D6 2b 11 37 37 11 37 37 11 37 37 11 37
29 01 00 00 00 00 02 00 F0
29 01 00 00 00 00 07 D6 37 11 37 37 11 37
29 01 00 00 00 00 02 00 00
29 01 00 00 00 00 02 81 81
29 01 00 00 00 00 02 00 90
29 01 00 00 00 00 02 CA AF
29 01 00 00 00 00 02 00 00 
29 01 00 00 00 00 04 ff ff ff ff 
29 01 00 00 05 00 02 53 00 
29 01 00 00 05 00 02 51 00
29 01 00 00 05 00 02 5E 00
29 01 00 00 05 00 02 55 01
29 01 00 00 78 00 01 11 
29 01 00 00 10 00 01 29];
		qcom,mdss-dsi-off-command = [05 01 00 00 32 00 02 28 00
					05 01 00 00 78 00 02 10 00];
		qcom,mdss-dsi-on-command-state = "dsi_lp_mode";
		qcom,mdss-dsi-off-command-state = "dsi_hs_mode";
		qcom,mdss-dsi-h-sync-pulse = <1>;
		qcom,mdss-dsi-traffic-mode = "burst_mode";
		qcom,mdss-dsi-bllp-eof-power-mode;
		qcom,mdss-dsi-bllp-power-mode;
		qcom,mdss-dsi-lane-0-state;
		qcom,mdss-dsi-lane-1-state;
		qcom,mdss-dsi-lane-2-state;
		qcom,mdss-dsi-lane-3-state;
		qcom,mdss-dsi-panel-timings = [82 1C 12 00 40 42 16 1E 14 03 04 00];
		qcom,mdss-dsi-t-clk-post = <0x04>;
		qcom,mdss-dsi-t-clk-pre = <0x1B>;
		qcom,mdss-dsi-bl-min-level = <10>;
		qcom,mdss-dsi-bl-max-level = <255>;
		qcom,mdss-dsi-dma-trigger = "trigger_sw";
		qcom,mdss-dsi-mdp-trigger = "none";
		qcom,mdss-dsi-bl-pmic-control-type = "bl_ctrl_dcs";
		qcom,mdss-dsi-reset-sequence = <1 20>, <0 20>, <1 160>;
	};
};
