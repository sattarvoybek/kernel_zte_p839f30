/* Copyright (c) 2013, The Linux Foundation. All rights reserved.
 *
 * This program is free software; you can redistribute it and/or modify
 * it under the terms of the GNU General Public License version 2 and
 * only version 2 as published by the Free Software Foundation.
 *
 * This program is distributed in the hope that it will be useful,
 * but WITHOUT ANY WARRANTY; without even the implied warranty of
 * MERCHANTABILITY or FITNESS FOR A PARTICULAR PURPOSE.  See the
 * GNU General Public License for more details.
 */

/*---------------------------------------------------------------------------
 * This file is autogenerated file using gcdb parser. Please do not edit it.
 * Update input XML file to add a new entry or update variable in this file
 * VERSION = "1.0"
 *---------------------------------------------------------------------------*/
&mdss_mdp {
	dsi_jdf_otm1284a_720p_video: qcom,mdss_dsi_jdf_otm1284a_720p_video {
		qcom,mdss-dsi-panel-name = "jdf otm1284a 720p video";
		qcom,cont-splash-enabled;
		qcom,mdss-dsi-panel-controller = <&mdss_dsi0>;
		qcom,mdss-dsi-panel-type = "dsi_video_mode";
		qcom,mdss-dsi-panel-destination = "display_1";
		qcom,mdss-dsi-panel-framerate = <60>;
		qcom,mdss-dsi-virtual-channel-id = <0>;
		qcom,mdss-dsi-stream = <0>;
		qcom,mdss-dsi-panel-width = <720>;
		qcom,mdss-dsi-panel-height = <1280>;
		qcom,mdss-dsi-h-front-porch = <52>;
		qcom,mdss-dsi-h-back-porch = <100>;
		qcom,mdss-dsi-h-pulse-width = <24>;
		qcom,mdss-dsi-h-sync-skew = <0>;
		qcom,mdss-dsi-v-back-porch = <20>;
		qcom,mdss-dsi-v-front-porch = <8>;
		qcom,mdss-dsi-v-pulse-width = <4>;
		qcom,mdss-dsi-h-left-border = <0>;
		qcom,mdss-dsi-h-right-border = <0>;
		qcom,mdss-dsi-v-top-border = <0>;
		qcom,mdss-dsi-v-bottom-border = <0>;
		qcom,mdss-dsi-bpp = <24>;
		qcom,mdss-dsi-color-order = "rgb_swap_rgb";
		qcom,mdss-dsi-underflow-color = <0xff>;
		qcom,mdss-dsi-border-color = <0>;
		qcom,mdss-dsi-on-command = [29 01 00 00 00 00 02 00 00 
29 01 00 00 00 00 04 FF 12 84 01 
29 01 00 00 00 00 02 00 80 
29 01 00 00 00 00 03 FF 12 84 
29 01 00 00 00 00 02 00 92 
29 01 00 00 00 00 03 FF 30 02 
29 01 00 00 00 00 02 00 91 
29 01 00 00 00 00 02 b0 92 
29 01 00 00 00 00 02 00 80 
29 01 00 00 00 00 0a C0 00 64 00 0F 11 00 64 0F 11 
29 01 00 00 00 00 02 00 90 
29 01 00 00 00 00 07 C0 00 5F 00 01 00 04 
29 01 00 00 00 00 02 00 A4 
29 01 00 00 00 00 02 C0 00 
29 01 00 00 00 00 02 00 B3 
29 01 00 00 00 00 03 C0 00 55 
29 01 00 00 00 00 02 00 81 
29 01 00 00 00 00 02 C1 55 
29 01 00 00 00 00 02 00 81 
29 01 00 00 00 00 03 C4 82 0a 
29 01 00 00 00 00 02 00 C6 
29 01 00 00 00 00 02 B0 03 
29 01 00 00 00 00 02 00 90 
29 01 00 00 00 00 05 F5 02 11 02 15 
29 01 00 00 00 00 02 00 90 
29 01 00 00 00 00 02 C5 50 
29 01 00 00 00 00 02 00 94 
29 01 00 00 00 00 02 C5 66 
29 01 00 00 00 00 02 00 B2 
29 01 00 00 00 00 03 F5 00 00 
29 01 00 00 00 00 02 00 B4 
29 01 00 00 00 00 03 F5 00 00 
29 01 00 00 00 00 02 00 B6 
29 01 00 00 00 00 03 F5 00 00 
29 01 00 00 00 00 02 00 B8 
29 01 00 00 00 00 03 F5 00 00 
29 01 00 00 00 00 02 00 94 
29 01 00 00 00 00 03 F5 00 00 
29 01 00 00 00 00 02 00 d2 
29 01 00 00 00 00 03 F5 06 15 
29 01 00 00 00 00 02 00 B2 
29 01 00 00 00 00 02 C5 40 
29 01 00 00 00 00 02 00 B4 
29 01 00 00 00 00 02 C5 cc 
29 01 00 00 00 00 02 00 A0 
29 01 00 00 00 00 0f C4 05 10 06 02 05 15 10 05 10 07 02 05 15 10 
29 01 00 00 00 00 02 00 B0 
29 01 00 00 00 00 03 C4 00 00 
29 01 00 00 00 00 02 00 91 
29 01 00 00 00 00 03 C5 19 52 
29 01 00 00 00 00 02 00 00 
29 01 00 00 00 00 03 D8 BC BC 
29 01 00 00 00 00 02 00 b3 
29 01 00 00 00 00 02 C5 84 
29 01 00 00 00 00 02 00 BB 
29 01 00 00 00 00 02 C5 8a 
29 01 00 00 00 00 02 00 c2 
29 01 00 00 00 00 02 f5 40 
29 01 00 00 00 00 02 00 c3 
29 01 00 00 00 00 02 f5 85 
29 01 00 00 00 00 02 00 00 
29 01 00 00 00 00 15 E1 02 09 0F 18 22 2D 2E 5A 4C 69 96 80 8D 67 61 4A 3C 27 16 02 
29 01 00 00 00 00 02 00 00 
29 01 00 00 00 00 15 E2 02 0A 10 19 22 2D 2E 5A 4C 6A 96 80 8D 67 61 4A 3C 27 16 02 
29 01 00 00 00 00 02 00 80 
29 01 00 00 00 00 0c CB 00 00 00 00 00 00 00 00 00 00 00 
29 01 00 00 00 00 02 00 90 
29 01 00 00 00 00 10 CB 00 00 00 00 00 00 00 00 00 00 00 00 00 00 00 
29 01 00 00 00 00 02 00 A0 
29 01 00 00 00 00 10 CB 00 00 00 00 00 00 00 00 00 00 00 00 00 00 00 
29 01 00 00 00 00 02 00 B0 
29 01 00 00 00 00 10 CB 00 00 00 00 00 00 00 00 00 00 00 00 00 00 00 
29 01 00 00 00 00 02 00 C0 
29 01 00 00 00 00 10 CB 05 05 05 05 05 05 05 05 05 00 00 00 00 00 00 
29 01 00 00 00 00 02 00 D0 
29 01 00 00 00 00 10 CB 00 00 00 05 05 05 05 05 05 05 05 05 05 05 05 
29 01 00 00 00 00 02 00 E0 
29 01 00 00 00 00 0f CB 05 00 00 00 00 00 00 00 00 00 05 05 05 05 
29 01 00 00 00 00 02 00 F0 
29 01 00 00 00 00 0c CB FF FF FF FF FF FF FF FF FF FF FF 
29 01 00 00 00 00 02 00 80 
29 01 00 00 00 00 10 CC 2d 2d 0a 0c 0e 10 00 00 00 00 00 00 00 00 00 
29 01 00 00 00 00 02 00 90 
29 01 00 00 00 00 10 CC 00 00 00 2e 2e 02 04 2d 2d 09 0b 0d 0f 00 00 
29 01 00 00 00 00 02 00 A0 
29 01 00 00 00 00 0f CC 00 00 00 00 00 00 00 00 00 00 2e 2e 01 03 
29 01 00 00 00 00 02 00 B0 
29 01 00 00 00 00 10 CC 2d 2e 0f 0d 0b 09 00 00 00 00 00 00 00 00 00 
29 01 00 00 00 00 02 00 C0 
29 01 00 00 00 00 10 CC 00 00 00 2e 2d 03 01 2d 2e 10 0e 0c 0a 00 00 
29 01 00 00 00 00 02 00 D0 
29 01 00 00 00 00 0f CC 00 00 00 00 00 00 00 00 00 00 2e 2d 04 02 
29 01 00 00 00 00 02 00 80 
29 01 00 00 00 00 0d CE 8D 03 29 8C 03 29 8B 03 29 8A 03 29 
29 01 00 00 00 00 02 00 90 
29 01 00 00 00 00 0f CE 00 00 00 00 00 00 00 00 00 00 00 00 00 00 
29 01 00 00 00 00 02 00 A0 
29 01 00 00 00 00 0f CE 38 0B 8D 00 8d 29 00 38 0A 8D 01 8d 29 00 
29 01 00 00 00 00 02 00 B0 
29 01 00 00 00 00 0f CE 38 09 8D 02 8d 29 00 38 08 8D 03 8d 29 00 
29 01 00 00 00 00 02 00 C0 
29 01 00 00 00 00 0f CE 38 07 8D 04 8d 29 00 38 06 8D 05 8d 29 00 
29 01 00 00 00 00 02 00 D0 
29 01 00 00 00 00 0f CE 38 05 8D 06 8d 29 00 38 04 8D 07 8d 29 00 
29 01 00 00 00 00 02 00 80 
29 01 00 00 00 00 0f CF 00 00 00 00 00 00 00 00 00 00 00 00 00 00 
29 01 00 00 00 00 02 00 90 
29 01 00 00 00 00 0f CF 00 00 00 00 00 00 00 00 00 00 00 00 00 00 
29 01 00 00 00 00 02 00 A0 
29 01 00 00 00 00 0f CF 00 00 00 00 00 00 00 00 00 00 00 00 00 00 
29 01 00 00 00 00 02 00 B0 
29 01 00 00 00 00 0f CF 00 00 00 00 00 00 00 00 00 00 00 00 00 00 
29 01 00 00 00 00 02 00 C0 
29 01 00 00 00 00 0c CF 01 01 20 20 00 00 01 01 00 00 00 
29 01 00 00 00 00 02 00 B5 
29 01 00 00 00 00 07 C5 3c 01 FF 3c 01 FF 
29 01 00 00 00 00 02 00 90
29 01 00 00 00 00 02 CA AF
29 01 00 00 00 00 02 00 00 
29 01 00 00 00 00 04 FF FF FF FF
29 01 00 00 05 00 02 53 00 
29 01 00 00 05 00 02 51 00
29 01 00 00 05 00 02 5E 00
29 01 00 00 05 00 02 55 01
29 01 00 00 78 00 01 11 
29 01 00 00 10 00 01 29];
		qcom,mdss-dsi-off-command = [05 01 00 00 32 00 02 28 00
					05 01 00 00 78 00 02 10 00];
		qcom,mdss-dsi-on-command-state = "dsi_lp_mode";
		qcom,mdss-dsi-off-command-state = "dsi_hs_mode";
		qcom,mdss-dsi-h-sync-pulse = <1>;
		qcom,mdss-dsi-traffic-mode = "burst_mode";
		qcom,mdss-dsi-bllp-eof-power-mode;
		qcom,mdss-dsi-bllp-power-mode;
		qcom,mdss-dsi-lane-0-state;
		qcom,mdss-dsi-lane-1-state;
		qcom,mdss-dsi-lane-2-state;
		qcom,mdss-dsi-lane-3-state;
		qcom,mdss-dsi-panel-timings = [7A 1A 12 00 3E 42 16 1E 14 03 04 00];
		qcom,mdss-dsi-t-clk-post = <0x04>;
		qcom,mdss-dsi-t-clk-pre = <0x1A>;
		qcom,mdss-dsi-bl-min-level = <10>;
		qcom,mdss-dsi-bl-max-level = <255>;
		qcom,mdss-dsi-dma-trigger = "trigger_sw";
		qcom,mdss-dsi-mdp-trigger = "none";
		qcom,mdss-dsi-bl-pmic-control-type = "bl_ctrl_dcs";
		qcom,mdss-dsi-reset-sequence = <1 20>, <0 20>, <1 160>;
	};
};
